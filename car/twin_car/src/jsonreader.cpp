#include "jsonreader.hpp"

// Define the embedded "Factory Default" file
// These symbols are generated by the linker from the embedded file
extern const char rfid_json_start[] asm("_binary_include_rfid_json_start");
extern const char rfid_json_end[]   asm("_binary_include_rfid_json_end");

JsonReader::JsonReader(const char* filePath) : _filePath(filePath){
}

bool JsonReader::begin() {
    if (!LittleFS.begin(true)) {
        Serial.println("LittleFS Mount Failed");
        return false;
    }

    // Check if file exists, if not restore from factory defaults
    if (!LittleFS.exists(_filePath)) {
        Serial.println("JSON file missing. Restoring Factory Defaults...");
        if (!restoreFactoryDefaults()) {
            Serial.println("Failed to restore factory defaults.");
            return false;
        }
    }

    return load();
}

bool JsonReader::load() {
    File file = LittleFS.open(_filePath, "r");
    if (!file) {
        Serial.printf("Failed to open %s for reading\n", _filePath);
        return false;
    }

    _doc.clear();
    DeserializationError error = deserializeJson(_doc, file);
    file.close();

    if (error) {
        Serial.print("JSON Read Failed: ");
        Serial.println(error.c_str());
        return false;
    }

    Serial.println("JSON Data Loaded Successfully");
    return true;
}

bool JsonReader::save() {
    File file = LittleFS.open(_filePath, "w");
    if (!file) {
        Serial.printf("Failed to open %s for writing\n", _filePath);
        return false;
    }

    if (serializeJson(_doc, file) == 0) {
        Serial.println("Failed to write to file");
        file.close();
        return false;
    }

    file.close();
    Serial.println("Database updated successfully!");
    return true;
}

bool JsonReader::findTag(const String& uidHex, JsonDocument& resultDoc) {
    JsonArray tiles = _doc["tiles"];
    
    for (JsonObject tile : tiles) {
        int tile_nr = tile["tile_nr"];
        const char* template_name = tile["template"];
        JsonObject bindings = tile["bindings"];
        
        // Search through all bindings in this tile
        for (JsonPair binding : bindings) {
            const char* tag_id = binding.value().as<const char*>();
            if (String(tag_id) == uidHex) {
                resultDoc["tag_id"] = tag_id;
                resultDoc["tile_nr"] = tile_nr;
                resultDoc["tag_index"] = binding.key().c_str();
                resultDoc["template"] = template_name;
                return true;
            }
        }
    }
    
    // Tag not found in database
    resultDoc["tag_id"] = uidHex;
    resultDoc["tile_nr"] = -1;
    resultDoc["tag_index"] = "unknown";
    resultDoc["template"] = "unknown";
    return false;
}

bool JsonReader::addTag(const String& uid, int tile_nr, const char* tag_index) {
    // Find the tile and add the binding
    JsonArray tiles = _doc["tiles"];
    
    for (JsonObject tile : tiles) {
        if (tile["tile_nr"] == tile_nr) {
            JsonObject bindings = tile["bindings"];
            bindings[tag_index] = uid;
            return save();
        }
    }
    
    Serial.println("Tile not found, cannot add tag");
    return false;
}

JsonDocument& JsonReader::getDocument() {
    return _doc;
}

enum road_types JsonReader::get_road_type_from_tag(const String& template_name) {
    Serial.println("Getting road type from template name: " + template_name);
    if (template_name == "STRAIGHT") {
        return STRAIGHT;
    } else if (template_name == "CURVE") {
        return CURVE;
    } else if (template_name == "ROUNDABOUT") {
        return ROUNDABOUT;
    } else if (template_name == "T_JUNCTION") {
        return T_JUNCTION;
    } else if (template_name == "CROSSROAD") {
        return CROSSROAD;
    } else if (template_name == "START") {
        return STRAIGHT; // Treat START as STRAIGHT
    } else {
        // Default case or unknown template
        return STRAIGHT;
    }
}

bool JsonReader::restoreFactoryDefaults() {
    File file = LittleFS.open(_filePath, "w");
    if (!file) {
        return false;
    }

    // Write the embedded data to the file system
    size_t len = rfid_json_end - rfid_json_start;
    size_t written = file.write((const uint8_t*)rfid_json_start, len);
    file.close();

    return written == len;
}
